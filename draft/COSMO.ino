#include <SPI.h>
#include <Wire.h>
#include <Adafruit_GFX.h>
#include <Adafruit_SSD1306.h>

#define OLED_RESET 4
Adafruit_SSD1306 display(OLED_RESET);

//#define NUMFLAKES 10
//#define XPOS 0
//#define YPOS 1
//#define DELTAY 2


#define ImageHeight1 64
#define ImageWidth1  88
static const unsigned char PROGMEM ImageArray1[] =
{
0x0,0x0,0x0,0x0,0x0,0x0,0x0,0x0,0x0,0x0,0x0,
0x0,0x0,0x0,0x0,0x0,0x0,0x0,0x0,0x0,0x0,0x0,
0x0,0x0,0x0,0x0,0x0,0x0,0x0,0x0,0x0,0x0,0x0,
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0x0,0x0,0x0,0x0,0x0,0x0,0x0,0x0,0x0,0x0,0x0
};

static const unsigned char PROGMEM ImageArray2[] =
{
0x0,0x0,0x0,0x0,0x0,0x0,0x0,0x0,0x0,0x0,0x0,
0x0,0x0,0x0,0x0,0x0,0x0,0x0,0x0,0x0,0x0,0x0,
0x0,0x0,0x0,0x0,0x0,0x0,0x0,0x0,0x0,0x0,0x0,
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0x0,0x0,0x0,0x0,0x0,0x0,0x0,0x0,0x0,0x0,0x0
};


#if (SSD1306_LCDHEIGHT != 64)
#error("Height incorrect, please fix Adafruit_SSD1306.h!");
#endif
//---------------

#include <Servo.h>

// Create servo objects to control a servo motors
Servo myservoR;
Servo myservoL;


int ContSerPinR = 17; // Set right motor pin
int ContSerPinL = 0; // Set left motor pin
int FullSpeedL = 180; // Set forward speed
int FullSpeedR = 0; // Set forward speed
int HalfSpeedL = 110; // Set half speed
int HalfSpeedR = 70; // Set half speed
int BackSpeedL = 0; // Set backward speed
int BackSpeedR = 180; // Set backward speed

int RobotMode = 1; // Set default mode, mode 1 is for non-upgraded robots
int Count = 0; // Create a counter object
unsigned long previousMillis = 0;        // will store last time LED was updated


// These are used for upgraded robots
int LineSensL = 10;
int LineSensR = 11;
const int JoyStkXPin = A0;
const int JoyStkYPin = A1;
const int JoyStkButtonPin = 12;
int JoyStkValX = 512;
int JoyStkValY = 512;


void setup() {
  Serial.begin(9600);
  display.begin(SSD1306_SWITCHCAPVCC, 0x3C);  // initialize with the I2C addr 0x3D (for the 128x64)
  // Clear the buffer.
  display.clearDisplay();
  delay(4000);

  display.clearDisplay();
  display.drawBitmap(10, (32 - (ImageHeight1 / 2)),  ImageArray1, ImageWidth1, ImageHeight1, 1);
  display.display();

  // starts driving the robot forward
  myservoL.attach(ContSerPinL);
  myservoR.attach(ContSerPinR);
  myservoL.write(FullSpeedL);
  myservoR.write(FullSpeedR);


  // Upgraded robot only, set to line sensing mode if line sensors are detected
  if (digitalRead(LineSensR) == HIGH) {
    RobotMode = 3;
  }
  pinMode(LineSensL, INPUT);
  pinMode(LineSensR, INPUT);
  digitalWrite(JoyStkButtonPin, HIGH); // Sets the upgraded robot joystick button HIGH
}

void loop() {
  // Upgraded robot only, set to joystick mode if the joystick button is pressed
  if (digitalRead(JoyStkButtonPin) == LOW) {
    RobotMode = 4;
  }

  // The case statements are so you can use different upgrades to the robot
  switch (RobotMode) {

    // case 1 and 2 are the defaults and are for non-upgraded robots
    case 1:
      // right turn box
      if (millis() - previousMillis >= 1500) {
        display.clearDisplay();
        display.drawBitmap(10, (32 - (ImageHeight1 / 2)),  ImageArray2, ImageWidth1, ImageHeight1, 1);
        display.display();

        myservoR.detach();
      }
      if (millis() - previousMillis >= 2250) {
        display.clearDisplay();
        display.drawBitmap(10, (32 - (ImageHeight1 / 2)),  ImageArray1, ImageWidth1, ImageHeight1, 1);
        display.display();

        myservoR.attach(ContSerPinR);
        myservoR.write(FullSpeedR);
        previousMillis = millis();
        Count ++;
      }
      if (Count >= 8) {
        Count = 0;
        RobotMode = 2;
      }
      break;

    case 2:
      //  left turn triangle
      if (millis() - previousMillis >= 1500) {
        display.clearDisplay();
        display.drawBitmap(10, (32 - (ImageHeight1 / 2)),  ImageArray2, ImageWidth1, ImageHeight1, 1);
        display.display();

        myservoL.detach();
      }
      if (millis() - previousMillis >= 2460) {
        display.clearDisplay();
        display.drawBitmap(10, (32 - (ImageHeight1 / 2)),  ImageArray1, ImageWidth1, ImageHeight1, 1);
        display.display();

        myservoL.attach(ContSerPinL);
        myservoL.write(FullSpeedL);
        previousMillis = millis();
        Count ++;
      }
      if (Count >= 6) {
        Count = 0;
        RobotMode = 1;
      }
      break;

    //  case 3 is for the line follower upgrade
    case 3:
      if (digitalRead(LineSensR) == LOW) {
        myservoL.attach(ContSerPinL);
        myservoL.write(HalfSpeedL);
      }
      if (digitalRead(LineSensL) == LOW) {
        myservoR.attach(ContSerPinR);
        myservoR.write(HalfSpeedR);
      }
      if (digitalRead(LineSensR) == HIGH) {
        myservoL.detach();
      }
      if (digitalRead(LineSensL) == HIGH) {
        myservoR.detach();
      }
      break;

    // case 4 is for the joystick controller upgrade
    case 4:
      JoyStkValY = analogRead(JoyStkYPin);
      JoyStkValY = map(JoyStkValY, 0, 1024, 100, -100);

      JoyStkValX = analogRead(JoyStkXPin);
      JoyStkValX = map(JoyStkValX, 0, 1024, -100, 100);

      if (JoyStkValY <= 5 && JoyStkValY >= -5) {
        myservoL.detach();
        myservoR.detach();
      }
      else {
        myservoL.attach(ContSerPinL);
        myservoR.attach(ContSerPinR);

        if (JoyStkValX > 5) {
          myservoL.write(90 + (FullSpeedL - 90) * JoyStkValY / 100 * (100 - JoyStkValX) / 100);
          myservoR.write(90 + (FullSpeedR - 90) * JoyStkValY / 100);
        }
        if (JoyStkValX < -5) {
          myservoL.write(90 + (FullSpeedL - 90) * JoyStkValY / 100);
          myservoR.write(90 + (FullSpeedR - 90) * JoyStkValY / 100 * (100 - abs(JoyStkValX)) / 100);
        }
      }
      break;
  }

}
